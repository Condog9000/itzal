## Firmware/ZMK/itzal_v1/modules/battery_gauge/Kconfig
```kconfig
config BATTERY_GAUGE
    bool "Battery Gauge LED Display"
    default n
    depends on ZMK_RGB_UNDERGLOW
    help
      Enable battery gauge display on WS2812 LEDs.
      Shows battery level using a color gradient from
      red (low) to green (full).

if BATTERY_GAUGE

config BATTERY_GAUGE_DISPLAY_MS
    int "Display duration in milliseconds"
    default 3000
    help
      How long to display the battery gauge before
      automatically turning off the LEDs.

config BATTERY_GAUGE_BRIGHTNESS
    int "LED brightness (0-255)"
    default 128
    range 0 255
    help
      Brightness level for the battery gauge LEDs.

config BATTERY_GAUGE_SHOW_ON_BOOT
    bool "Show battery gauge on boot"
    default y
    help
      Display battery level briefly when the keyboard boots.

config BATTERY_GAUGE_LED_COUNT
    int "Number of LEDs for battery gauge"
    default 5
    help
      Number of LEDs to use for the battery gauge display.

endif # BATTERY_GAUGE
```

## Firmware/ZMK/itzal_v1/modules/battery_gauge/dts/bindings/zmk,behavior-battery-gauge.yaml
```yaml
description: Battery gauge display behavior

compatible: "zmk,behavior-battery-gauge"

include: zero_param.yaml
```

## Firmware/ZMK/itzal_v1/west.yml
```yaml
manifest:
  remotes:
    - name: zmkfirmware
      url-base: https://github.com/zmkfirmware
  projects:
    - name: zmk
      remote: zmkfirmware
      revision: 8568d02b0bcf2c1876bf29210b294ac53b9521a6
      import: app/west.yml
  self:
    path: itzal_v1
```
